## examples/zephyr/common/config/Kconfig
```kconfig
# Copyright (c) Blecon Ltd
# SPDX-License-Identifier: Apache-2.0

config LARGE_REQUEST_EXAMPLE_BUFFER_SZ
    int "Buffer size for large request example"
    default 32768

menu "Zephyr Kernel"
source "Kconfig.zephyr"
endmenu
```

## examples/zephyr/common/config/boards/nucleo_l433rc_p.conf
```kconfig
# Copyright (c) Blecon Ltd
# SPDX-License-Identifier: Apache-2.0

# External modem platform dependencies
CONFIG_SERIAL=y
CONFIG_RING_BUFFER=y
CONFIG_UART_INTERRUPT_DRIVEN=y

# External modem platform
CONFIG_BLECON_PORT_EVENT_LOOP=y
CONFIG_BLECON_PORT_UART=y

# Enable external modem
CONFIG_BLECON_EXTERNAL_MODEM=y

# Reduce stack sizes
CONFIG_MAIN_STACK_SIZE=8192
CONFIG_SYSTEM_WORKQUEUE_STACK_SIZE=4096

# Reduce large request buffer size
CONFIG_LARGE_REQUEST_EXAMPLE_BUFFER_SZ=16384
```

## examples/zephyr/memfault/sysbuild/mcuboot/boards/bl54l15_dvk_nrf54l15_cpuapp.conf
```kconfig
# Copyright (c) Blecon Ltd
# SPDX-License-Identifier: Apache-2.0

# Ensure that the qspi driver is disabled by default
CONFIG_SPI_NOR=n
```

// Copyright (c) Blecon Ltd
// SPDX-License-Identifier: Apache-2.0

/ {
    chosen {
        zephyr,console = &uart0;
        zephyr,shell-uart = &uart0;
        zephyr,uart-mcumgr = &uart0;
        zephyr,bt-mon-uart = &uart0;
        zephyr,bt-c2h-uart = &uart0;
    };
};

/delete-node/ &zephyr_udc0;
// Copyright (c) Blecon Ltd
// SPDX-License-Identifier: Apache-2.0

// We don't use cpuflpr, so allocate all RRAM and SRAM to cpuapp
&cpuapp_rram {
	reg = <0x0 DT_SIZE_K(1524)>;
};

&cpuapp_sram {
    reg = <0x20000000 DT_SIZE_K(256)>;
};

// Enable NFC peripheral for all nrf54l15-based boards
// (upstream nrf54l15dk has this, but some third-party nRF54L15 boards do not)
&nfct {
	status = "okay";
};

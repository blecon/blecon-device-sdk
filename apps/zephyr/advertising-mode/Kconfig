## apps/zephyr/advertising-mode/Kconfig
```kconfig
# Copyright (c) Blecon Ltd
# SPDX-License-Identifier: Apache-2.0

rsource "../common/config/Kconfig"
```

## apps/zephyr/memfault/sysbuild/mcuboot/boards/nrf52840dk_nrf52840.conf
```kconfig
# Copyright (c) Blecon Ltd
# SPDX-License-Identifier: Apache-2.0

# Ensure that the qspi driver is disabled by default
CONFIG_NORDIC_QSPI_NOR=n
```

## apps/zephyr/memfault/sysbuild/mcuboot/boards/nrf52840dongle_nrf52840.conf
```kconfig
# Copyright (c) Blecon Ltd
# SPDX-License-Identifier: Apache-2.0

CONFIG_NORDIC_QSPI_NOR=n

# Explicitly disable USB stack
CONFIG_USB_DEVICE_STACK=n
CONFIG_USB_CDC_ACM=n

# Enable uart driver
CONFIG_SERIAL=y

# Enable console
CONFIG_CONSOLE=y
CONFIG_UART_CONSOLE=y
```

## examples/zephyr/boards/ezurio/bl54l15u_dvk/board.yml
```yaml
board:
  name: bl54l15u_dvk
  vendor: nordic
  socs:
  - name: nrf54l15
    variants:
    - name: xip
      cpucluster: cpuflpr
    - name: ns
      cpucluster: cpuapp
```

## examples/zephyr/boards/fanstel/fanstel_ev_bm15m/Kconfig.fanstel_ev_bm15m
```kconfig
# Copyright (c) 2024 Nordic Semiconductor ASA
# SPDX-License-Identifier: Apache-2.0

config BOARD_FANSTEL_EV_BM15M
	select SOC_NRF54L15_CPUAPP if BOARD_FANSTEL_EV_BM15M_NRF54L15_CPUAPP || BOARD_FANSTEL_EV_BM15M_NRF54L15_CPUAPP_NS
	select SOC_NRF54L15_CPUFLPR if BOARD_FANSTEL_EV_BM15M_NRF54L15_CPUFLPR || \
					    BOARD_FANSTEL_EV_BM15M_NRF54L15_CPUFLPR_XIP
```

## examples/zephyr/boards/fanstel/fanstel_ev_bm15m/board.yml
```yaml
board:
  name: fanstel_ev_bm15m
  vendor: nordic
  socs:
  - name: nrf54l15
    variants:
    - name: xip
      cpucluster: cpuflpr
    - name: ns
      cpucluster: cpuapp
```

## examples/zephyr/boards/insightsip/isp2454_lx_eb/Kconfig.isp2454_lx_eb
```kconfig
# Copyright (c) 2024 Nordic Semiconductor ASA
# SPDX-License-Identifier: Apache-2.0

config BOARD_ISP2454_LX_EB
	select SOC_NRF54L15_ENGA_CPUAPP if BOARD_ISP2454_LX_EB_NRF54L15_CPUAPP || BOARD_ISP2454_LX_EB_NRF54L15_CPUAPP_NS
	select SOC_NRF54L15_ENGA_CPUFLPR if BOARD_ISP2454_LX_EB_NRF54L15_CPUFLPR || \
					    BOARD_ISP2454_LX_EB_NRF54L15_CPUFLPR_XIP
```

## examples/zephyr/boards/insightsip/isp2454_lx_eb/board.yml
```yaml
board:
  name: isp2454_lx_eb
  vendor: nordic
  socs:
  - name: nrf54l15
    variants:
    - name: xip
      cpucluster: cpuflpr
    - name: ns
      cpucluster: cpuapp
```

## examples/zephyr/boards/kkm/k7p54l/Kconfig.k7p54l
```kconfig
# Copyright (c) 2024 Nordic Semiconductor ASA
# SPDX-License-Identifier: Apache-2.0

config BOARD_K7P54L
	select SOC_NRF54L15_CPUAPP if BOARD_K7P54L_NRF54L15_CPUAPP || BOARD_K7P54L_NRF54L15_CPUAPP_NS
	select SOC_NRF54L15_CPUFLPR if BOARD_K7P54L_NRF54L15_CPUFLPR || \
					    BOARD_K7P54L_NRF54L15_CPUFLPR_XIP
```

## examples/zephyr/boards/kkm/k7p54l/board.yml
```yaml
board:
  name: k7p54l
  vendor: nordic
  socs:
  - name: nrf54l15
    variants:
    - name: xip
      cpucluster: cpuflpr
    - name: ns
      cpucluster: cpuapp
```

## examples/zephyr/boards/kkm/kkm_k7p54l_bcn/Kconfig.kkm_k7p54l_bcn
```kconfig
# Copyright (c) 2024 Nordic Semiconductor ASA
# SPDX-License-Identifier: Apache-2.0

config BOARD_KKM_K7P54L_BCN
	select SOC_NRF54L15_CPUAPP if BOARD_KKM_K7P54L_BCN_NRF54L15_CPUAPP || BOARD_KKM_K7P54L_BCN_NRF54L15_CPUAPP_NS
	select SOC_NRF54L15_CPUFLPR if BOARD_KKM_K7P54L_BCN_NRF54L15_CPUFLPR || \
					    BOARD_KKM_K7P54L_BCN_NRF54L15_CPUFLPR_XIP
```

## examples/zephyr/boards/kkm/kkm_k7p54l_bcn/board.yml
```yaml
board:
  name: kkm_k7p54l_bcn
  vendor: kkm
  revision:
    format: major.minor.patch
    default: 1.1.0
    exact: false
    revisions:
    - name: 1.0.0
    - name: 1.1.0
  socs:
  - name: nrf54l15
    variants:
    - name: xip
      cpucluster: cpuflpr
    - name: ns
      cpucluster: cpuapp
```

## examples/zephyr/boards/kkm/kkm_s5_bcn/Kconfig
```kconfig
# Copyright (c) Blecon Ltd
# SPDX-License-Identifier: Apache-2.0

config BOARD_ENABLE_DCDC
	bool "DCDC mode"
	select SOC_DCDC_NRF52X
	default y
	depends on BOARD_KKM_S5_BCN
```

## examples/zephyr/boards/kkm/kkm_s5_bcn/Kconfig.defconfig
```kconfig
# Copyright (c) Blecon Ltd
# SPDX-License-Identifier: Apache-2.0

# KKM S5 BCN board configuration

if BOARD_KKM_S5_BCN

config BT_CTLR
	default BT

endif # BOARD_KKM_S5_BCN
```

## examples/zephyr/boards/kkm/kkm_s5_bcn/Kconfig.kkm_s5_bcn
```kconfig
# Copyright (c) Blecon Ltd
# SPDX-License-Identifier: Apache-2.0

config BOARD_KKM_S5_BCN
    select SOC_NRF52833_QIAA
```

## examples/zephyr/boards/kkm/kkm_s5_bcn/board.yml
```yaml
# Copyright (c) Blecon Ltd
# SPDX-License-Identifier: Apache-2.0
board:
  name: kkm_s5_bcn
  vendor: kkm
  socs:
  - name: nrf52833
```

## examples/zephyr/boards/kkm/kkm_s5_bcn/kkm_s5_bcn_defconfig
```kconfig
# Copyright (c) Blecon Ltd
# SPDX-License-Identifier: Apache-2.0

# Enable MPU
CONFIG_ARM_MPU=y

# Enable hardware stack protection
CONFIG_HW_STACK_PROTECTION=y

# Enable RTT
CONFIG_USE_SEGGER_RTT=y

# enable GPIO
CONFIG_GPIO=y

# dynamically detect flash part
CONFIG_SPI_NOR_SFDP_RUNTIME=y
```

## examples/zephyr/boards/minew/minew_me54be01/Kconfig.minew_me54be01
```kconfig
# Copyright (c) 2024 Nordic Semiconductor ASA
# SPDX-License-Identifier: Apache-2.0

config BOARD_MINEW_ME54BE01
	select SOC_NRF54L15_CPUAPP if BOARD_MINEW_ME54BE01_NRF54L15_CPUAPP || BOARD_MINEW_ME54BE01_NRF54L15_CPUAPP_NS
	select SOC_NRF54L15_CPUFLPR if BOARD_MINEW_ME54BE01_NRF54L15_CPUFLPR || \
					    BOARD_MINEW_ME54BE01_NRF54L15_CPUFLPR_XIP
```

## examples/zephyr/boards/minew/minew_me54be01/board.yml
```yaml
board:
  name: minew_me54be01
  vendor: nordic
  socs:
  - name: nrf54l15
    variants:
    - name: xip
      cpucluster: cpuflpr
    - name: ns
      cpucluster: cpuapp
```

## examples/zephyr/boards/mokosmart/mokosmart_l02s_bcn/Kconfig.mokosmart_l02s_bcn
```kconfig
# Copyright (c) 2024 Nordic Semiconductor ASA
# SPDX-License-Identifier: Apache-2.0

config BOARD_MOKOSMART_L02S_BCN
	select SOC_NRF54L15_CPUAPP if BOARD_MOKOSMART_L02S_BCN_NRF54L15_CPUAPP || BOARD_MOKOSMART_L02S_BCN_NRF54L15_CPUAPP_NS
	select SOC_NRF54L15_CPUFLPR if BOARD_MOKOSMART_L02S_BCN_NRF54L15_CPUFLPR || \
					    BOARD_MOKOSMART_L02S_BCN_NRF54L15_CPUFLPR_XIP
```

## examples/zephyr/boards/mokosmart/mokosmart_l02s_bcn/board.yml
```yaml
# Copyright (c) Blecon Ltd
# SPDX-License-Identifier: Apache-2.0
board:
  name: mokosmart_l02s_bcn
  vendor: mokosmart
  socs:
  - name: nrf54l15
    variants:
    - name: xip
      cpucluster: cpuflpr
    - name: ns
      cpucluster: cpuapp
```

## examples/zephyr/boards/nrf52840dk_nrf52840.conf
```kconfig
# Copyright (c) Blecon Ltd
# SPDX-License-Identifier: Apache-2.0

# Select internal modem
CONFIG_BLECON_EXTERNAL_MODEM=n
CONFIG_BLECON_INTERNAL_MODEM=y
CONFIG_BLECON_INTERNAL_MODEM_NFC=y

# Internal modem platform
CONFIG_BLECON_PORT_CRYPTO=y
CONFIG_BLECON_PORT_NVM=y
CONFIG_BLECON_PORT_BLUETOOTH=y
CONFIG_BLECON_PORT_EVENT_LOOP=y
CONFIG_BLECON_PORT_NFC=y

# Bluetooth
CONFIG_BT=y
CONFIG_BT_PERIPHERAL=y
CONFIG_BT_USER_PHY_UPDATE=y

# At the moment, the following options are required to get L2CAP dynamic channels enabled
CONFIG_BT_SMP=y
# CONFIG_BT_CONN_DISABLE_SECURITY=y
CONFIG_BT_PRIVACY=n

CONFIG_BT_EXT_ADV=y
CONFIG_BT_L2CAP_DYNAMIC_CHANNEL=y
CONFIG_BT_EXT_ADV_MAX_ADV_SET=3
CONFIG_BT_ID_MAX=3
CONFIG_BT_LONG_WQ=n
CONFIG_BT_BONDABLE=n
CONFIG_BT_GATT_SERVICE_CHANGED=n
CONFIG_BT_GATT_CACHING=n
CONFIG_BT_GATT_ENFORCE_SUBSCRIPTION=n
CONFIG_BT_GATT_READ_MULTIPLE=n
CONFIG_BT_DEVICE_NAME="Blecon"
CONFIG_BT_DIS=y
CONFIG_BT_DIS_PNP=n
CONFIG_BT_ECC=n

# Needs to be 1 + number of expected connections; See: https://devzone.nordicsemi.com/f/nordic-q-a/77588/advertising-failed-to-start-err--12/321268
CONFIG_BT_MAX_CONN=2

# Needed to achieve MTU without fragmentation
CONFIG_BT_BUF_ACL_TX_COUNT=8
CONFIG_BT_BUF_ACL_TX_SIZE=251
CONFIG_BT_BUF_ACL_RX_SIZE=251

# Increase HCI RX stack size
CONFIG_BT_RX_STACK_SIZE=4096

# Bluetooth controller
# Uncomment to use the Zephyr link layer
# CONFIG_BT_LL_SW_SPLIT=y
CONFIG_BT_CTLR_CRYPTO=n
CONFIG_BT_CTLR_LE_ENC=n
CONFIG_BT_CTLR_ECDH=n
CONFIG_BT_CTLR_PHY_2M=n
CONFIG_BT_CTLR_PRIVACY=n
CONFIG_BT_LL_SOFTDEVICE_MULTIROLE=y

# NFC
CONFIG_NFC_T2T_NRFXLIB=y
CONFIG_NFC_NDEF_URI_MSG=y
CONFIG_NFC_NDEF=y
CONFIG_NFC_NDEF_MSG=y
CONFIG_NFC_NDEF_RECORD=y
CONFIG_NFC_NDEF_URI_REC=y

# Crypto
CONFIG_ENTROPY_GENERATOR=y

CONFIG_NRF_SECURITY=y
CONFIG_MBEDTLS_PSA_CRYPTO_C=y

CONFIG_MBEDTLS_ENABLE_HEAP=y
CONFIG_MBEDTLS_HEAP_SIZE=8192

# NVM
CONFIG_FLASH=y
CONFIG_FLASH_PAGE_LAYOUT=y
```

## examples/zephyr/boards/nrf52840dongle_nrf52840.conf
```kconfig
# Copyright (c) Blecon Ltd
# SPDX-License-Identifier: Apache-2.0

# Disable NFC
CONFIG_BLECON_NFC=n

# Enable console
CONFIG_CONSOLE=y
```

## examples/zephyr/boards/panasonic/panb511evb/board.yml
```yaml
board:
  name: panb511evb
  vendor: panasonic
  socs:
  - name: nrf54l15
    variants:
    - name: xip
      cpucluster: cpuflpr
```

## examples/zephyr/boards/raytac/raytac_an54l15q_db/board.yml
```yaml
board:
  name: raytac_an54l15q_db
  vendor: nordic
  socs:
  - name: nrf54l15
    variants:
    - name: xip
      cpucluster: cpuflpr
    - name: ns
      cpucluster: cpuapp
```

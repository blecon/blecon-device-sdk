## apps/zephyr/boards/kkm/kkm_k7p54l_bcn/Kconfig.defconfig
```kconfig
# Copyright (c) 2024 Nordic Semiconductor ASA
# SPDX-License-Identifier: Apache-2.0

if BOARD_KKM_K7P54L_BCN_NRF54L15_CPUAPP

config ROM_START_OFFSET
	default 0 if PARTITION_MANAGER_ENABLED
	default 0x800 if BOOTLOADER_MCUBOOT

endif # BOARD_KKM_K7P54L_BCN_NRF54L15_CPUAPP
```

## apps/zephyr/boards/kkm/kkm_k7p54l_bcn/Kconfig.kkm_k7p54l_bcn
```kconfig
# Copyright (c) 2024 Nordic Semiconductor ASA
# SPDX-License-Identifier: Apache-2.0

config BOARD_KKM_K7P54L_BCN
	select SOC_NRF54L15_CPUAPP if BOARD_KKM_K7P54L_BCN_NRF54L15_CPUAPP
```

## apps/zephyr/boards/kkm/kkm_k7p54l_bcn/board.yml
```yaml
board:
  name: kkm_k7p54l_bcn
  full_name: KKM K7P54L-BCN Beacon
  vendor: kkm
  revision:
    format: major.minor.patch
    default: 1.1.0
    exact: false
    revisions:
    - name: 1.0.0
    - name: 1.1.0
  socs:
  - name: nrf54l15
```

## apps/zephyr/boards/kkm/kkm_s5_bcn/board.yml
```yaml
# Copyright (c) Blecon Ltd
# SPDX-License-Identifier: Apache-2.0
board:
  name: kkm_s5_bcn
  full_name: KKM S5-BCN Beacon
  vendor: kkm
  socs:
  - name: nrf52833
```

## apps/zephyr/boards/mokosmart/mokosmart_l02s_bcn/Kconfig.defconfig
```kconfig
# Copyright (c) 2024 Nordic Semiconductor ASA
# SPDX-License-Identifier: Apache-2.0

if 	BOARD_MOKOSMART_L02S_BCN_NRF54L15_CPUAPP

config ROM_START_OFFSET
	default 0 if PARTITION_MANAGER_ENABLED
	default 0x800 if BOOTLOADER_MCUBOOT

endif # BOARD_MOKOSMART_L02S_BCN_NRF54L15_CPUAPP
```

## apps/zephyr/boards/mokosmart/mokosmart_l02s_bcn/Kconfig.mokosmart_l02s_bcn
```kconfig
# Copyright (c) 2024 Nordic Semiconductor ASA
# SPDX-License-Identifier: Apache-2.0

config BOARD_MOKOSMART_L02S_BCN
	select SOC_NRF54L15_CPUAPP if BOARD_MOKOSMART_L02S_BCN_NRF54L15_CPUAPP
```

## apps/zephyr/boards/mokosmart/mokosmart_l02s_bcn/board.yml
```yaml
# Copyright (c) Blecon Ltd
# SPDX-License-Identifier: Apache-2.0
board:
  name: mokosmart_l02s_bcn
  full_name: MokoSmart L02S-BCN Beacon
  vendor: mokosmart
  socs:
  - name: nrf54l15
```

/*
 * Copyright (c) 2024 Nordic Semiconductor ASA
 *
 * SPDX-License-Identifier: Apache-2.0
 */

/dts-v1/;

#include "nrf54l15_cpuapp_common.dtsi"

/ {
	compatible = "nordic,mokosmart_l02s_bcn_nrf54l15-cpuapp";
	model = "Mokosmart L02S nRF54L15 Application MCU";

	chosen {
		zephyr,code-partition = &slot0_partition;
		zephyr,sram = &cpuapp_sram;
	};
};
